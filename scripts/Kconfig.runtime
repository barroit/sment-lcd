## scripts/Kconfig.runtime
```kconfig
# SPDX-License-Identifier: GPL-3.0-or-later

menu "Runtime defaults"

config UTF8_LOCALE
	string "Default LC_CTYPE"
	default "$(utf8-locale)"

endmenu # Runtime defaults
```
